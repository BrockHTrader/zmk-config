## boards/shields/mint34/Kconfig.defconfig
```kconfig
if SHIELD_MINT34_LEFT

config ZMK_KEYBOARD_NAME
    default "Mint34"

config ZMK_SPLIT
    default y

config ZMK_SPLIT_ROLE_CENTRAL
    default n

endif # SHIELD_MINT34_LEFT

if SHIELD_MINT34_RIGHT

config ZMK_KEYBOARD_NAME
    default "Mint34"

config ZMK_SPLIT
    default y

config ZMK_SPLIT_ROLE_CENTRAL
    default n

endif # SHIELD_MINT34_RIGHT

if SHIELD_MINT34_DONGLE

config ZMK_KEYBOARD_NAME
    default "Mint34"

config ZMK_SPLIT
    default y

config ZMK_SPLIT_ROLE_CENTRAL
    default y

config ZMK_SPLIT_BLE_CENTRAL_PERIPHERALS
    default 2

config BT_MAX_CONN
    default 7

config BT_MAX_PAIRED
    default 7

config ZMK_USB
    default y

endif # SHIELD_MINT34_DONGLE
```

## boards/shields/mint34/Kconfig.shield
```kconfig
config SHIELD_MINT34_LEFT
    def_bool $(shields_list_contains,mint34_left)

config SHIELD_MINT34_RIGHT
    def_bool $(shields_list_contains,mint34_right)

config SHIELD_MINT34_DONGLE
    def_bool $(shields_list_contains,mint34_dongle)
```
