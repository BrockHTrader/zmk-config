// This file was generated from a template. Edit it to match your keyboard.
// See https://zmk.dev/docs/development/hardware-integration/new-shield for more
// instructions.

#include "mint34.dtsi"

&default_transform {
    // Set this to the number of columns on the left side.
    col-offset = <5>;
};

&kscan0 {
    col-gpios
        = <&gpio1 0 GPIO_ACTIVE_HIGH>   /* Col 0 - pinky */
        , <&gpio0 24 GPIO_ACTIVE_HIGH>   /* Col 1 */
        , <&gpio0 22 GPIO_ACTIVE_HIGH>   /* Col 2 */
        , <&gpio0 20 GPIO_ACTIVE_HIGH>   /* Col 3 */
        , <&gpio0 17  GPIO_ACTIVE_HIGH>   /* Col 4 - inner */
        ;
};
